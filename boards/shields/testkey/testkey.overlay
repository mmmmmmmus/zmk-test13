// nayutyl.overlay

#include <dt-bindings/zmk/matrix_transform.h>

/ {

    chosen {
        zmk,kscan = &kscan0;
        zmk,matrix-transform = &default_transform;
    };

    default_transform: keymap_transform_0 {
        compatible = "zmk,matrix-transform";
        columns = <2>; // 列数を2に設定
        rows = <1>;    // 行数を1に設定
        
        map = <
            RC(0,0) RC(0,1)
        >;
    };

    kscan0: kscan {
        compatible = "zmk,kscan-gpio-matrix";
        wakeup-source;

        diode-direction = "col2row"; // ダイオードの向き

        row-gpios
            = <&gpio0 4 (GPIO_ACTIVE_HIGH | GPIO_PULL_DOWN)>
            ; // 行は1つだけ
          col-gpios
            = <&gpio0 5 (GPIO_PULL_UP)> // 列はプルアップが一般的
            , <&gpio0 6 (GPIO_PULL_UP)>
            ; // 列は2つ
    };
};