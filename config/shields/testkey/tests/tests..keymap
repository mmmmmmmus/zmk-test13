
/*
 * Copyright (c) 2020 The ZMK Contributors
 *
 * SPDX-License-Identifier: MIT
 */

#include <behaviors.dtsi>
#include <dt-bindings/zmk/keys.h>
#include <dt-bindings/zmk/bt.h>

&mt {
    tapping-term-ms = <300>;
    flavor = "tap-preferred";
};

/ {
    keymap {
        compatible = "zmk,keymap";

        default_layer {
                        bindings = <
    &kp Q       &kp W       
                >;
        };
    };
};
