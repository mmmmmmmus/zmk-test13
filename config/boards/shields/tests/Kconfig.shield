## config/shields/testkey/tests/Kconfig.defconfig
```kconfig
# Copyright (c) 2020 The ZMK Contributors
# SPDX-License-Identifier: MIT

if SHIELD_TESTS

config ZMK_KEYBOARD_NAME
	default "TESTS"

endif
```
